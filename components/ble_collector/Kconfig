## components/ble_collector/Kconfig
```kconfig
menu "PlantHub BLE Collector"

config PLANTHUB_BLE_SCAN_ITVL_MS
    int "BLE scan interval (ms)"
    default 200
    help
        Time between scan window starts. Larger interval = more airtime for WiFi.

config PLANTHUB_BLE_SCAN_WINDOW_MS
    int "BLE scan window (ms)"
    default 60 if IDF_TARGET_ESP32C5
    default 80
    help
        Active listen time per interval. The C5 (single core, shared radio)
        defaults lower to keep the web UI responsive (PlanV1 3.1).

        The C6 deliberately has NO arm here and takes the generic 80. Its
        correct value is a radio-coexistence question, and the C3's 60 was
        measured on a chip whose WiFi was independently unreliable under
        BLE load (66% packet loss, HTTP wedging under request bursts).
        Copying that number to a different radio would be cargo cult. The
        M6a hardware gate measures C6 coexistence explicitly; set an arm
        here from that number, not before it.

endmenu
```

## components/claiming/Kconfig
```kconfig
menu "PlantHub Claiming"

config PLANTHUB_FACTORY_RESET_GPIO
    int "GPIO for the 10-second factory-reset hold"
    default 9 if IDF_TARGET_ESP32C6
    default 28 if IDF_TARGET_ESP32C5
    default 0
    help
        Pin that must be held low for 10 seconds to clear the claim key,
        WiFi credentials and swarm role/pairing. This is the documented
        last-resort recovery for a device that cannot be reached any
        other way -- a locked-out hub, or a node that runs no web server
        at all because it is paired (see PlanV1 section 8e/8f) -- so it
        has to match the BOOT button of the board actually in use.

        The default follows the target's own BOOT button: GPIO9 on
        ESP32-C6 devkits, GPIO28 on ESP32-C5 ones. The trailing GPIO0 is
        only Kconfig's required terminal default for an unlisted target;
        no supported board uses it.

        Getting this wrong is not cosmetic. This was once hardcoded to
        GPIO0, and it was found on hardware that no amount of holding
        BOOT reset an ESP32-C3 node -- GPIO0 is simply not wired to a
        button there, so the only documented recovery path did nothing at
        all on what was then the primary target. That chip was dropped in
        M6a; the lesson was not, which is why the C6 value above was
        verified on hardware instead of taken from a datasheet. At M6a's
        gate a 10-second hold on GPIO9 of an ESP32-C6-DevKitC-1 cleared
        the claim key and the WiFi credentials and dropped the hub back to
        AP mode, while its 3 plants and 1 rule survived -- the documented
        contract exactly. Any new board still has to be checked the same
        way before a release ships; that is the part the C3 incident
        actually taught, and it does not expire because one board passed.
        Change this only for a custom board whose button is on some other
        pin.

endmenu
```

## components/h2_link/Kconfig
```kconfig
menu "PlantHub H2 link"

config PLANTHUB_H2_LINK_ENABLED
    bool "Enable the wired H2 Zigbee coordinator link"
    default n
    help
        The two-chip (C6 + H2) appliance transport: a framed UART1 link to a
        dedicated ESP32-H2 Zigbee coordinator. The C6 brain owns the H2 as a
        local radio over this link instead of running its own 802.15.4 stack.
        Set this together with CONFIG_PLANTHUB_ZB_ENABLED=n (the C6 has no
        local Zigbee radio in the two-chip appliance) -- h2_link then backs
        the webserver's local-coordinator permit/status seam.

endmenu
```

## components/integrations/Kconfig
```kconfig
menu "PlantHub Integrations"

config PLANTHUB_INFLUX_TLS
    bool "Enable HTTPS for the InfluxDB client"
    default n
    help
        A policy switch, not a build switch: when enabled,
        integr_config_set() accepts https:// URLs in the Influx config
        in addition to http://. It does NOT gate anything at build
        time -- esp_http_client and esp-tls link into the firmware
        either way in this IDF config, so leaving this off does not
        save flash.

        Enabling it today buys you an HTTPS client with NO certificate
        verification wired up: no CA bundle, no pinning. The transport
        is encrypted but the server is not authenticated, which is not
        meaningfully stronger than the plain-http trusted-LAN model
        this project otherwise assumes (PlanV1 3.7). Certificate-bundle
        wiring is future work; until it lands, prefer http:// and only
        turn this on if you understand and accept that gap. The MQTT
        client is unaffected either way (always plain mqtt:// in v1).

endmenu
```

## components/radio_role/Kconfig
```kconfig
menu "PlantHub radio role"

choice PLANTHUB_DEFAULT_RADIO_ROLE
    prompt "Default radio role (when NVS radio_role is unset)"
    default PLANTHUB_RADIO_ROLE_WIFI_ONLY
    help
        One universal image, radio chosen at runtime: this selects what
        STARTS on a hub whose NVS has no radio_role yet. wifi_only is the
        shipped default: a fresh hub brings up WiFi and the web UI, and the
        onboarding step asks the user to pick WiFi only or BLE (a reboot
        applies BLE). ble exists for bench builds. (zigbee was a choice
        while Zigbee bridge nodes existed; retired 2026-10 -- Zigbee now
        comes from the two-chip hub's wired H2.)

config PLANTHUB_RADIO_ROLE_WIFI_ONLY
    bool "wifi_only (neither BLE nor Zigbee)"
config PLANTHUB_RADIO_ROLE_BLE
    bool "ble"
endchoice

endmenu
```

## components/rtc_ds3231/Kconfig
```kconfig
menu "PlantHub RTC"

config PLANTHUB_RTC_DS3231
    bool "Enable the optional DS3231 I2C RTC"
    default n
    help
        Read a DS3231 real-time clock over I2C (SDA=GPIO6, SCL=GPIO7, addr
        0x68) at boot to seed the hub's wall clock before WiFi/SNTP, and keep
        it trained from SNTP / browser time-sets. Absent-tolerant: with no
        module fitted the hub falls back to SNTP exactly as before. See
        docs/esplayout/h2-link-wiring.md.

endmenu
```

## components/sampler/Kconfig
```kconfig
menu "PlantHub Sampler"

config PLANTHUB_SAMPLE_INTERVAL_MIN
    int "History sample interval (minutes)"
    range 1 60
    default 15

endmenu
```

## components/storage/Kconfig
```kconfig
menu "PlantHub Storage"

config PLANTHUB_HISTORY_RAW_CAP
    int "Raw-tier history ring capacity (samples per plant)"
    default 2880
    help
        Number of raw-tier storage_rec_t slots kept per plant, ring-buffer
        style (oldest overwritten first). Each ring file is a fixed-size
        preallocation of this many 22-byte records plus a small header, so
        this directly sizes the "storage" littlefs partition's raw-history
        footprint per plant.

        Lower only for a custom partition table with less "storage" space;
        raising it risks exhausting the partition once enough plants are
        actively sampled.

        The C6 takes the generic 2880, even though its 16 MB
        layout gives "storage" 8000K (partitions_16m.csv) and could hold
        far more -- one plant's raw ring is only about 63 KB at this cap.
        That headroom is banked on purpose (M6a spec section 5): the
        milestone raises no capacity limit on the strength of available
        space alone. Raise this when something actually needs deeper raw
        history, with the reason recorded.

config PLANTHUB_HISTORY_HOURLY_CAP
    int "Hourly-tier history ring capacity (samples per plant)"
    default 720
    help
        Number of hourly-aggregated storage_rec_t slots kept per plant
        (720 hours = 30 days at one bucket/hour). Same ring-buffer
        semantics and per-plant file as the raw tier, just coarser.

endmenu
```

## components/swarm/Kconfig
```kconfig
menu "PlantHub Swarm"

config PLANTHUB_WIFI_COUNTRY
    string "WiFi regulatory domain / country code"
    default "01"
    help
        The regulatory domain determines which channels a node may sweep
        during pairing/resync, and which channel a main hub's WiFi
        association is allowed to sit on. "01" is the IDF's world-safe
        default and restricts operation to channels 1-11. An actual ISO
        country code for a region that permits channels 12-13 (most of
        the EU, including Switzerland) enables them -- without this, a
        node can never find a hub whose router happens to land on
        channel 12 or 13, a silent and permanent pairing failure.

        WARNING: setting a country code for a region these devices do
        not actually operate in is a regulatory violation. Only set this
        to a code that matches where the hardware will really be used.

endmenu
```

## components/wrappers/Kconfig
```kconfig
menu "PlantHub Wrappers"

config PLANTHUB_WRAPPER_ARENA
    int "Wrapper bytecode arena size (bytes)"
    default 4096 if IDF_TARGET_ESP32C6
    default 2048
    help
        Size of the shared LRU-evicted arena holding LOADED wrapper
        bytecode blobs (M3 spec section 2), packed by their actual size
        rather than a fixed slot each -- this is what makes the 16-wrapper,
        2 KB-bytecode-each store affordable on a small part: the store
        itself is a flash limit (16 * 2 KB, LittleFS), the arena is the RAM
        cost, and the two are deliberately not the same number. A realistic
        wrapper compiles to a few hundred bytes, so this default holds
        several of them resident at once; only a pathological near-2 KB
        wrapper fills it alone.

        The C6 (512 KB SRAM) takes 4096. The trailing 2048 is Kconfig's terminal default for an
        unlisted target, and is also the value tests/host/test_wrapper_arena.c
        exercises -- deliberately the tighter number, so packing and
        eviction are actually stressed by the host test rather than being
        given room to never evict.

endmenu
```

## components/zigbee/Kconfig
```kconfig
menu "PlantHub Zigbee"

config PLANTHUB_ZB_ENABLED
    bool "Enable the Zigbee coordinator"
    default y if IDF_TARGET_ESP32H2
    default n
    help
        The Zigbee coordinator, which since 2026-10 runs only on the ESP32-H2
        of the two-chip hub (planthubos/h2fw/, which pulls this component in and needs
        an 802.15.4 radio plus the zb_storage/zb_fct partitions). The C6 hub
        builds keep it off -- a C6 never runs a coordinator itself; its only
        use was the retired Zigbee bridge node -- and talk to the H2 over
        h2_link instead. The component still compiles on the C6 as stubs.

config PLANTHUB_ZB_PERMIT_JOIN_S
    int "Permit-join window (seconds)"
    default 180
    range 30 254
    help
        How long the network accepts new devices after the user presses
        Pair. The window is a window, never a mode: it closes on expiry,
        on a successful join, and on reboot. A permanently open network
        lets any device in radio range join.

endmenu
```

## main/Kconfig.projbuild
```kconfig
choice PLANTHUB_DEFAULT_RADIO_ROLE
    prompt "Default radio role (fallback when NVS radio_role unset)"
    default PLANTHUB_RADIO_ROLE_BLE
    help
        One universal image, one radio per node chosen at runtime. Both the
        BLE and Zigbee stacks are compiled in; this selects which one STARTS
        when NVS has no radio_role yet. The config UI will write radio_role
        (a reboot applies it); this is only the first-boot fallback.

config PLANTHUB_RADIO_ROLE_WIFI_ONLY
    bool "wifi_only (neither BLE nor Zigbee)"
config PLANTHUB_RADIO_ROLE_BLE
    bool "ble"
config PLANTHUB_RADIO_ROLE_ZIGBEE
    bool "zigbee"
endchoice
```
